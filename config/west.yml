## config/west.yml
```yaml
manifest:
  remotes:
    - name: fruitjuice088
      url-base: https://github.com/fruitjuice088
  projects:
    - name: zmk_shingeta
      remote: fruitjuice088
      revision: main
      import: app/west.yml
  self:
    path: config
```
